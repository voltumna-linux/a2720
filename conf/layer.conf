## conf/layer.conf
```bitbake
# We have a conf and classes directory, add to BBPATH
BBPATH .= ":${LAYERDIR}"

# We have recipes-* directories, add to BBFILES
BBFILES += "${LAYERDIR}/recipes-*/*/*.bb ${LAYERDIR}/recipes-*/*/*.bbappend"

BBFILE_COLLECTIONS += "a2720"
BBFILE_PATTERN_a2720 = "^${LAYERDIR}/"
BBFILE_PRIORITY_a2720 = "11"

# This should only be incremented on significant changes that will
# cause compatibility issues with other layers
LAYERVERSION_a2720 = "1"

LAYERDEPENDS_a2720 = "core"

LAYERSERIES_COMPAT_a2720 = "dunfell"
```
